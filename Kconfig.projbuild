## Kconfig.projbuild
```kconfig
menu "libespili9341 Configuration"

    config ILI9341_PIN_DC
        int "D/C GPIO number"
        range 0 16
        default 4
        help
            Defines the pin used for the D/C (data/command) signal in
            communication with ili9341 display.

endmenu
```
